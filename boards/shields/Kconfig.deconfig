## boards/shields/Kconfig.deconfig
```kconfig
if SHIELD_NUM64
            
 config ZMK_KEYBOARD_NAME
     default "Num64"

endif
```

## boards/shields/num64/Kconfig.defconfig
```kconfig
if SHIELD_NUM64
            
 config ZMK_KEYBOARD_NAME
     default "num64"

endif
```
